## main/Kconfig.projbuild
```kconfig
menu "Wi-Fi Configuration"
    choice WIFI_MODE
        prompt "Wi-Fi Connection Mode"
        default WIFI_MODE_WPA2
        help
            Choose between regular WPA2 or eduroam WPA2 Enterprise.

        config WIFI_MODE_WPA2
            bool "Regular WPA2"
        config WIFI_MODE_EDUROAM
            bool "eduroam (WPA2 Enterprise)"
    endchoice

    config WIFI_SSID
        string "Wi-Fi SSID"
        default "your_wifi_ssid"
        help
            SSID (network name) for the Wi-Fi connection.

    config WIFI_PASSWORD
        string "Wi-Fi Password"
        default "your_wifi_password"
        help
            Wi-Fi password (WPA or WPA2) for the Wi-Fi connection.
            Not used for eduroam.

    config EDUROAM_IDENTITY
        string "eduroam Identity"
        default "your-email@university.edu"
        depends on WIFI_MODE_EDUROAM
        help
            eduroam identity (usually your university email).

    config EDUROAM_USERNAME
        string "eduroam Username"
        default "your-email@university.edu"
        depends on WIFI_MODE_EDUROAM
        help
            eduroam username (usually your university email).

    config EDUROAM_PASSWORD
        string "eduroam Password"
        default "xxxxxxx"
        depends on WIFI_MODE_EDUROAM
        help
            eduroam password.
endmenu

menu "Team Configuration"
    config TEAM_KEY_0
        hex "Team Key Byte 0"
        default 0x00
        help
            First byte of the 16-byte team key for packet authentication.

    config TEAM_KEY_1
        hex "Team Key Byte 1"
        default 0x01
        help
            Second byte of the 16-byte team key.

    config TEAM_KEY_2
        hex "Team Key Byte 2"
        default 0x02
        help
            Third byte of the 16-byte team key.

    config TEAM_KEY_3
        hex "Team Key Byte 3"
        default 0x03
        help
            Fourth byte of the 16-byte team key.

    config TEAM_KEY_4
        hex "Team Key Byte 4"
        default 0x04
        help
            Fifth byte of the 16-byte team key.

    config TEAM_KEY_5
        hex "Team Key Byte 5"
        default 0x05
        help
            Sixth byte of the 16-byte team key.

    config TEAM_KEY_6
        hex "Team Key Byte 6"
        default 0x06
        help
            Seventh byte of the 16-byte team key.

    config TEAM_KEY_7
        hex "Team Key Byte 7"
        default 0x07
        help
            Eighth byte of the 16-byte team key.

    config TEAM_KEY_8
        hex "Team Key Byte 8"
        default 0x08
        help
            Ninth byte of the 16-byte team key.

    config TEAM_KEY_9
        hex "Team Key Byte 9"
        default 0x09
        help
            Tenth byte of the 16-byte team key.

    config TEAM_KEY_10
        hex "Team Key Byte 10"
        default 0x0A
        help
            Eleventh byte of the 16-byte team key.

    config TEAM_KEY_11
        hex "Team Key Byte 11"
        default 0x0B
        help
            Twelfth byte of the 16-byte team key.

    config TEAM_KEY_12
        hex "Team Key Byte 12"
        default 0x0C
        help
            Thirteenth byte of the 16-byte team key.

    config TEAM_KEY_13
        hex "Team Key Byte 13"
        default 0x0D
        help
            Fourteenth byte of the 16-byte team key.

    config TEAM_KEY_14
        hex "Team Key Byte 14"
        default 0x0E
        help
            Fifteenth byte of the 16-byte team key.

    config TEAM_KEY_15
        hex "Team Key Byte 15"
        default 0x0F
        help
            Sixteenth byte of the 16-byte team key.
endmenu
```
